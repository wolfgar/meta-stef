## conf/layer.conf
```bitbake
# We have a conf and classes directory, add to BBPATH
BBPATH .= ":${LAYERDIR}"

# We have recipes-* directories, add to BBFILES
BBFILES += "${LAYERDIR}/recipes-*/*/*.bb \
	${LAYERDIR}/recipes-*/*/*.bbappend"

BBFILE_COLLECTIONS += "stef"
BBFILE_PATTERN_stef = "^${LAYERDIR}/"
BBFILE_PRIORITY_stef = "7"
```

## conf/local.conf.sample
```bitbake
MACHINE = 'wandboard-quad'
DISTRO ?= 'poky'
DISTRO_FEATURES_DEFAULT="alsa argp bluetooth ext2 irda largefile pcmcia usbgadget usbhost wifi xattr nfs zeroconf pci"
DISTRO_FEATURES = "${DISTRO_FEATURES_DEFAULT} ${DISTRO_FEATURES_LIBC} \
                    multiarch systemd"
PACKAGE_CLASSES ?= "package_rpm"
EXTRA_IMAGE_FEATURES = "debug-tweaks"
USER_CLASSES ?= "buildstats image-mklibs image-prelink"
PATCHRESOLVE = "noop"
BB_DISKMON_DIRS = "\
    STOPTASKS,${TMPDIR},1G,100K \
    STOPTASKS,${DL_DIR},1G,100K \
    STOPTASKS,${SSTATE_DIR},1G,100K \
    ABORT,${TMPDIR},100M,1K \
    ABORT,${DL_DIR},100M,1K \
    ABORT,${SSTATE_DIR},100M,1K" 
CONF_VERSION = "1"

BB_NUMBER_THREADS = '4'
PARALLEL_MAKE = '-j 4'
ACCEPT_FSL_EULA = ""
DEFAULTTUNE ?= "cortexa9thf-neon"
SDKMACHINE = "x86_64"
EXTRA_IMAGE_FEATURES += "package-management"
LICENSE_FLAGS_WHITELIST="commercial"

# Ensure boot scripts will be available at rootfs time
do_rootfs[depends] += "u-boot:do_deploy"
BOOT_SCRIPTS = "bootscript-${MACHINE}:boot.scr"
```

## conf/machine/udoo-quad.conf
```bitbake
#@TYPE: Machine
#@NAME: Utilite pro i.MX6 Quad
#@SOC: i.MX6Q
#@DESCRIPTION: Machine configuration for i.MX6 utilite pro

include conf/machine/include/imx-base.inc
include conf/machine/include/tune-cortexa9.inc

SOC_FAMILY = "mx6:mx6q:udoo"

PREFERRED_PROVIDER_virtual/kernel = "linux-udoo"
PREFERRED_PROVIDER_u-boot = "u-boot-udoo"
PREFERRED_PROVIDER_virtual/bootloader = "u-boot-udoo"


UBOOT_MACHINE = "udoo_quad_config"

SERIAL_CONSOLE = "115200 ttymxc3"

MACHINE_FEATURES += " pci wifi bluetooth"

#MACHINE_FIRMWARE += "linux-firmware-sd8787"
```

## conf/machine/utilite.conf
```bitbake
#@TYPE: Machine
#@NAME: Utilite pro i.MX6 Quad
#@SOC: i.MX6Q
#@DESCRIPTION: Machine configuration for i.MX6 utilite pro

include conf/machine/include/imx-base.inc
include conf/machine/include/tune-cortexa9.inc

SOC_FAMILY = "mx6:mx6q:utilite"

PREFERRED_PROVIDER_virtual/kernel = "linux-utilite"
PREFERRED_PROVIDER_u-boot = "u-boot-utilite"
PREFERRED_VERSION_u-boot-imx = "2009.08"
PREFERRED_PROVIDER_virtual/bootloader = "u-boot-utilite"
UBOOT_MACHINE = "cm_fx6_mx6q_2gb_config"
UBOOT_SUFFIX = "bin"
UBOOT_PADDING = "2"

SERIAL_CONSOLE = "115200 ttymxc3"

MACHINE_FEATURES += " pci wifi bluetooth"

MACHINE_FIRMWARE += "linux-firmware-sd8787"
```
